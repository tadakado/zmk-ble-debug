## Kconfig
```kconfig
# ============================================================================
#  BLE bond / profile dump behavior
# ============================================================================
config ZMK_BEHAVIOR_BLE_DUMP
    bool
    default y
    depends on DT_HAS_ZMK_BEHAVIOR_BLE_DUMP_ENABLED

# ============================================================================
#  Periodic host-link RSSI logger
# ============================================================================
config ZMK_BLE_RSSI
    bool "Periodically log the RSSI of host BLE connections"
    default n
    depends on ZMK_BLE
    select BT_CTLR_CONN_RSSI
    help
      Every ZMK_BLE_RSSI_INTERVAL_SEC seconds, read the connection RSSI (HCI Read
      RSSI) of each BLE link where this device is the peripheral -- i.e. a host
      such as a PC / phone, not the split other-half -- and log it. Useful for
      diagnosing weak-signal / interference disconnects. Off by default; enable it
      while debugging.

config ZMK_BLE_RSSI_INTERVAL_SEC
    int "BLE RSSI log interval (seconds)"
    depends on ZMK_BLE_RSSI
    default 5

# ============================================================================
#  Connection event logger
# ============================================================================
config ZMK_BLE_CONN_LOG
    bool "Log BLE connect / disconnect (with HCI reason) / param updates at INF"
    default y
    depends on ZMK_BLE
    depends on !ZMK_SPLIT || ZMK_SPLIT_ROLE_CENTRAL
    help
      ZMK logs the disconnect reason only at DBG level. This logs connection
      events of every LE link (host links and, on a split central, the
      peripheral half / other links it opened) at INF, including the HCI
      disconnect reason, e.g. 0x08 supervision timeout (radio) vs 0x13 remote
      user terminated (the other side hung up). Only fires on events, so it is
      cheap enough to leave on.

config ZMK_BLE_CONN_LOG_FAIL_INTERVAL_SEC
    int "Repeat a recurring connect failure at most once per this many seconds"
    depends on ZMK_BLE_CONN_LOG
    default 600
    help
      A central link that keeps failing to connect (e.g. a sleeping BLE mouse
      being retried every 3 s) logs the first failure, then at most one line
      per this interval with the number of suppressed repeats. 0 logs all.
```

## dts/bindings/behaviors/zmk,behavior-ble-dump.yaml
```yaml
description: Log the BLE profile / bond list to the console.
compatible: "zmk,behavior-ble-dump"
include: zero_param.yaml
```
